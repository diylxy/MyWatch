#include "config.h"

struct_oled_sprite oled_sprite[OLED_MAX_SPIRITS];
struct_oled_inverse oled_inverse_bar;

volatile uint8_t oled_buffer[1024] = {0};
volatile uint8_t oled_tmpstr[50];
///////////////////////////////
uint8_t idata bitmap [8] = {0x01,0x02,0x04,0x08,0x10,0x20,0x40,0x80};
uint8_t idata bitmap1 [8] = {0x01,0x03,0x07,0x0f,0x1f,0x3f,0x7f,0xff};
uint8_t code oled_font_6x8[][6] =
{
	0x00, 0x00, 0x00, 0x00, 0x00, 0x00,// sp
	0x00, 0x00, 0x00, 0x2f, 0x00, 0x00,// !
	0x00, 0x00, 0x07, 0x00, 0x07, 0x00,// "
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	0x14, 0x14, 0x14, 0x14, 0x14, 0x14,// horiz lines
};


uint8_t code oled_font_64x32[] = 
{

0x00,0x00,0x00,0x00,0x00,0x00,0x00,0x00,0x00,0x00,0x00,0x00,0x00,0x00,0x00,0x00,
0x00,0x00,0x00,0x00,0x00,0x00,0x00,0x00,0x00,0x00,0x00,0x00,0x00,0x00,0x00,0x00,
0x00,0x00,0x00,0x00,0x00,0x00,0x00,0x00,0x80,0xC0,0xE0,0x70,0x30,0x38,0x18,0x18,
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0x00,0x00,0x00,0x00,0x00,0x00,0x00,0x00,0x00,0x00,0x00,0x00,0x00,0x00,0x00,0x00,//99
};


uint8_t code oled_font_8x16[] = 
{
0x00,0x00,0x00,0xF8,0x00,0x00,0x00,0x00,0x00,0x00,0x00,0x33,0x00,0x00,0x00,0x00,//!33
0x00,0x10,0x0C,0x02,0x10,0x0C,0x02,0x00,0x00,0x00,0x00,0x00,0x00,0x00,0x00,0x00,//"34
0x00,0x40,0xC0,0x78,0x40,0xC0,0x78,0x00,0x00,0x04,0x3F,0x04,0x04,0x3F,0x04,0x00,//#35
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0x00,0x00,0x00,0x00,0x00,0x00,0x00,0x00,0x00,0x00,0x00,0x00,0x00,0x00,0x00,0x00,//127
};
uint8_t code oled_init_cmd[]=
{
		0xAE, 0x20, 0x10, 0xb0,
		0xc8, 0x00, 0x10, 0x40,
		0x81, 0x80, 0xa1, 0xa6,
		0xa8, 0x3F, 0xa4, 0xd3,
		0x00, 0xd5, 0xf0, 0xd9,
		0x22, 0xda, 0x12, 0xdb,
		0x20, 0x8d, 0x14, 0xaf
};



int16_t max(int16_t a ,int16_t b)
{
	if(a > b)
		return a;
	return b;
}

int16_t min(int16_t a ,int16_t b)
{
	if(a < b)
		return a;
	return b;
}
void oled_wr_cmd(uint8_t cmd)
{
	OLED_CS = 0;
	OLED_DC = 0;
	OLED_WR = 0;
	OLED_DATA = cmd;
	OLED_WR = 1;
	OLED_CS = 1;
}

void oled_wr_dat(uint8_t dat)
{
	OLED_CS = 0;
		OLED_DC = 1;
		OLED_WR = 0;
		OLED_DATA = dat;
		OLED_WR = 1;
	OLED_CS = 1;
}

void oled_send_buffer()
{
	uint8_t i ,j;

	for(i = 0;i != 8; ++i)
	{
		oled_wr_cmd(0xb0+i);		//page0-page1
		oled_wr_cmd(0x00);		//low column start address
		oled_wr_cmd(0x10);		//high column start address
		OLED_CS = 0;
		OLED_DC = 1;
		for(j = 0; j != 128; ++j)
		{
			OLED_WR = 0;
			OLED_DATA = oled_buffer[128*i+j];
			OLED_WR = 1;
		}
	}
	OLED_CS = 1;
}
void oled_clear_buffer()
{
	uint16_t i;
	for(i = 0; i != 1024; ++i)
	{
		oled_buffer[i] = 0;
	}
}

void oled_init_sprites()
{
	uint8_t i;
	
	for(i = 0; i != OLED_MAX_SPIRITS; ++i)
	{
		oled_sprite[i].x = oled_sprite[i].y = oled_sprite[i].now_x = oled_sprite[i].now_y = 64;
		oled_sprite[i].w = oled_sprite[i].h = 0;
		oled_sprite[i].enable= 0;
		oled_sprite[i].gooff=0;
		oled_sprite[i].speed=0;
	}
}
void oled_clear_sprites()
{
	uint8_t i;
	
	for(i = 0; i != OLED_MAX_SPIRITS; ++i)
	{
		oled_sprite[i].gooff = 1;
		oled_sprite[i].speed = 0;
	}
}

void oled_remove_sprite(uint8_t num)
{
	oled_sprite[num].gooff = 1;
	oled_sprite[num].speed = 0;
}

void oled_init()  //Initial_M096128x64_ssd1306
{
	uint8_t i=255;
	OLED_RST=0;
	while(--i)_nop_();
	OLED_RST=1;
  i=255;
	while(--i)_nop_();
	
	for(i=0; i<28; i++)
		oled_wr_cmd(oled_init_cmd[i]);
	
	oled_inverse_bar.x = 0;
	oled_inverse_bar.y = 0;
	oled_inverse_bar.x_end = 0;
	oled_inverse_bar.y_end = 0;
	oled_inverse_bar.now_x = 0;
	oled_inverse_bar.now_y = 0;
	oled_inverse_bar.now_x_end = 0;
	oled_inverse_bar.now_y_end = 0;
	oled_inverse_bar.enable = 0;
}
int8_t oled_sprite_find()
{
	uint8_t i;
	for(i=0; i<OLED_MAX_SPIRITS; ++i)
	{
		if(oled_sprite[i].enable == 0)
			return i;
	}
	return -1;
}
int8_t oled_sprite_change_6x8(uint8_t sprite_num, int8_t x, int8_t y, uint8_t str[])
{
	oled_sprite_change_str_6x8(sprite_num, str);
	
	oled_sprite[sprite_num].gooff = 0;
	oled_sprite[sprite_num].x = x;
	oled_sprite[sprite_num].y = y;
	oled_sprite[sprite_num].enable = 1;
	
	return sprite_num;
}

void oled_inverse(int8_t x, int8_t y, int8_t x_end, int8_t y_end)
{
	
	oled_inverse_bar.x = x;
	oled_inverse_bar.y = y;
	oled_inverse_bar.x_end = x_end;
	oled_inverse_bar.y_end = y_end;
	
}

void oled_enable_inverse(uint8_t enable)
{
	
	oled_inverse_bar.enable = enable;
	
}
void oled_proc_sprites()
{
	uint8_t idata i;
	int8_t idata now_x;
	int8_t idata x_top, y_top;
	int8_t idata x_start, idata y_start;
	bit changed = 0;
	for(i = 0; i != OLED_MAX_SPIRITS; ++i)
	{
		if(oled_sprite[i].enable)
		{
			if(oled_sprite[i].gooff == 1)
			{
				if(oled_sprite[i].speed < 4)
					oled_sprite[i].speed += 1;
					else if(oled_sprite[i].speed < 8)
						oled_sprite[i].speed += 3;
					else if(oled_sprite[i].speed < 16)
						oled_sprite[i].speed += 5;
					else
						oled_sprite[i].speed += 8;
				oled_sprite[i].now_y += oled_sprite[i].speed;
				if(oled_sprite[i].now_y > OLED_Y_MAX)
				{
					oled_sprite[i].enable = 0;
					oled_sprite[i].gooff = 0;
					oled_sprite[i].speed = 0;
					oled_sprite[i].now_y = oled_sprite[i].now_x = 0;
					continue;
				}
			}
			else
			{
				if(oled_sprite[i].x != oled_sprite[i].now_x)
				{
					changed=1;
					now_x = abs(oled_sprite[i].x - oled_sprite[i].now_x);
					if(now_x < 4)
						now_x = 1;
					else if(now_x <  8)
						now_x = 3;
					else if(now_x < 16)
						now_x = 5;
					else
						now_x = 8;
					if(oled_sprite[i].x < oled_sprite[i].now_x)now_x *= -1;
					oled_sprite[i].now_x += now_x;
				}
				
				if(oled_sprite[i].y != oled_sprite[i].now_y)
				{
					changed=1;
					now_x = abs(oled_sprite[i].y - oled_sprite[i].now_y);
					if(now_x < 4)
						now_x = 1;
					else if(now_x <  8)
						now_x = 3;
					else if(now_x < 16)
						now_x = 5;
					else
						now_x = 8;
					if(oled_sprite[i].y < oled_sprite[i].now_y)now_x *= -1;
					oled_sprite[i].now_y += now_x;
				}
			}
			if(oled_sprite[i].now_x + oled_sprite[i].w < 0 ||oled_sprite[i].now_y >= 64 || oled_sprite[i].now_y + oled_sprite[i].h < 0)
			{
				oled_sprite[i].enable=0;
				oled_sprite[i].now_x = oled_sprite[i].now_y = 0;
				oled_sprite[i].gooff=0;
				oled_sprite[i].speed=0;
				continue;
			}

			oled_draw_bitmap_fast(oled_sprite[i].now_x, oled_sprite[i].now_y, oled_sprite[i].buffer, oled_sprite[i].w, oled_sprite[i].h, 0, 0);
		}
	}
	
	////////////反白显示
	if(oled_inverse_bar.enable)
	{
		
		if(oled_inverse_bar.x != oled_inverse_bar.now_x)
		{
			changed=1;
			now_x = oled_inverse_bar.x - oled_inverse_bar.now_x;
			if(abs(now_x) < OLED_ANIMATION_SPEED)
			{
				if(now_x < 0)
				{
					now_x = -1;
				}
				else
				{
					now_x = 1;
				}
			}
			else
			{
				now_x /= OLED_ANIMATION_SPEED;
				if(now_x > 13)now_x = 13;
			}
			oled_inverse_bar.now_x += now_x;
		}
		if(oled_inverse_bar.y != oled_inverse_bar.now_y)
		{
			changed=1;
			now_x = oled_inverse_bar.y - oled_inverse_bar.now_y;
			if(abs(now_x)< OLED_ANIMATION_SPEED)
			{
				if(now_x < 0)
				{
					now_x = -1;
				}
				else
				{
					now_x = 1;
				}
			}
			else
			{
				now_x /= OLED_ANIMATION_SPEED;
				if(now_x > 13)now_x = 13;
			} 
			oled_inverse_bar.now_y += now_x;
		}
		if(oled_inverse_bar.x_end != oled_inverse_bar.now_x_end)
		{
			changed=1;
			now_x = oled_inverse_bar.x_end - oled_inverse_bar.now_x_end;
			if(abs(now_x) < OLED_ANIMATION_SPEED)
			{
				if(now_x < 0)
				{
					now_x = -1;
				}
				else
				{
					now_x = 1;
				}
			}
			else
			{
				now_x /= OLED_ANIMATION_SPEED;
				if(now_x > 13)now_x = 13;
			}
			oled_inverse_bar.now_x_end += now_x;
		}
		if(oled_inverse_bar.y_end != oled_inverse_bar.now_y_end)
		{
			changed=1;
			now_x = oled_inverse_bar.y_end - oled_inverse_bar.now_y_end;
			if(abs(now_x) < OLED_ANIMATION_SPEED)
			{
				if(now_x < 0)
				{
					now_x = -1;
				}
				else
				{
					now_x = 1;
				}
			}
			else
			{
				now_x /= OLED_ANIMATION_SPEED;
				if(now_x > 13)now_x = 13;
			}
			oled_inverse_bar.now_y_end += now_x;
		}
		
		
		x_start = max(oled_inverse_bar.now_x, 0);
		y_start = max(oled_inverse_bar.now_y, 0);
		x_top = min(OLED_X_MAX-1, oled_inverse_bar.now_x_end);
		y_top = min(OLED_Y_MAX-1, oled_inverse_bar.now_y_end);
		if(x_top < 0 || y_top < 0)goto end;
		oled_fill_rect(x_start, y_start, x_top, y_top);
	}
	end:
	if(changed == 0)TR1 = 0;
}




uint8_t oled_sprite_get_height(uint8_t num)
{
	return oled_sprite[num].h;
}

uint8_t oled_sprite_get_width(uint8_t num)
{
	return oled_sprite[num].w;
}

void oled_sprite_move(uint8_t num, int8_t x, int8_t y)
{
	oled_sprite[num].gooff = 0;
	oled_sprite[num].x = x;
	oled_sprite[num].y = y;
	oled_sprite[num].enable = 1;
}

void oled_sprite_move_direct(uint8_t num, int8_t x, int8_t y)
{
	oled_sprite[num].gooff = 0;
	oled_sprite[num].x= oled_sprite[num].now_x = x;
	oled_sprite[num].y= oled_sprite[num].now_y = y;
	oled_sprite[num].enable = 1;
}

void oled_sprite_move_all_up(uint8_t distance)
{
	uint8_t num;
	for(num = 0; num < OLED_MAX_SPIRITS; ++num)
	{
		if(oled_sprite[num].gooff == 0)
		{
			oled_sprite[num].y -= distance;
		}
	}
}

void oled_sprite_move_all_down(uint8_t distance)
{
	uint8_t num;
	for(num = 0; num < OLED_MAX_SPIRITS; ++num)
	{
		if(oled_sprite[num].gooff == 0)
		{
			oled_sprite[num].y += distance;
		}
	}
}

void oled_sprite_change_str_6x8(uint8_t sprite_num, uint8_t* str)
{
	uint8_t i;
	uint8_t buffer_pos = 0;
	uint8_t c;
	

	if(sprite_num >= OLED_MAX_SPIRITS)
	{
		return;
	}
	
	while(c=*(str++))
	{
		c -= ' ';
		for(i = 0; i!= 6; ++i)
		{
			oled_sprite[sprite_num].buffer[buffer_pos] = oled_font_6x8[c][i];
			buffer_pos++;
		}
	}
	
	oled_sprite[sprite_num].w = buffer_pos;
	oled_sprite[sprite_num].h = 8;
	oled_sprite[sprite_num].enable = 1;
}












void oled_sprite_change_pic(uint8_t sprite_num, int8_t x, int8_t y, uint8_t w, uint8_t h, uint8_t *dat)
{
	uint16_t res;
	res = w*h;
	if(res % 8)res += 0x08;
	res/=8;
	memcpy(oled_sprite[sprite_num].buffer, dat, max(res, 256));
	oled_sprite[sprite_num].gooff = 0;
	oled_sprite[sprite_num].x = x;
	oled_sprite[sprite_num].y = y;
	oled_sprite[sprite_num].w = w;
	oled_sprite[sprite_num].h = h;
	oled_sprite[sprite_num].enable = 1;
}

void oled_sprite_change_gb2312(uint8_t num, int8_t x, int8_t y, uint8_t *str)
{
	oled_sprite_change_str_gb2312(num, str);
	oled_sprite[num].gooff = 0;
	oled_sprite[num].x = x;
	oled_sprite[num].y = y;
}	

void oled_sprite_change_str_gb2312(uint8_t num, uint8_t *str)
{
	uint8_t *str1 = str;
	uint16_t data_pos = 0;
	uint32_t foffset;
	uint8_t qh, ql;
	while(*str1)
	{
		qh=*str1++;
		ql=*str1++;
		if(qh < 0x80)
		{
			//ASCII码
			str1--;
			memcpy(oled_sprite[num].buffer + data_pos, oled_font_8x16 + (uint16_t)(qh-'!')*16, 8);
			data_pos += 8;
			if(data_pos >127)break;
			continue;
		}
		ql -= 0xa1;
		qh -= 0xa1;
		foffset = ((uint32_t)94*qh + ql)*(16 * 2) + FLASH_GB2312_START;
		flash_read(foffset, 16, oled_sprite[num].buffer + data_pos);
		data_pos += 16;
		if(data_pos > 127)break;
	}
	str1 = str;
	while(*str1)
	{
		qh=*str1++;
		ql=*str1++;
		if(qh < 0x80)
		{
			//ASCII码
			str1--;
			memcpy(oled_sprite[num].buffer + data_pos, oled_font_8x16 + (uint16_t)(qh-'!')*16 + 8, 8);
			data_pos += 8;
			if(data_pos > 255)break;
			continue;
		}
		ql -= 0xa1;
		qh -= 0xa1;
		foffset = ((uint32_t)94*qh + ql)*(16 * 2) + FLASH_GB2312_START + 16;
		flash_read(foffset, 16, oled_sprite[num].buffer + data_pos);
		data_pos += 16;
		if(data_pos > 255)break;
	}
	oled_sprite[num].w = data_pos / 2;
	oled_sprite[num].h = 16;
	oled_sprite[num].enable = 1;
}	

/////////////////////////////////直接读写缓冲区部分
void oled_draw_6x8(uint8_t x, uint8_t page, uint8_t* str)
{
	uint8_t i;
	uint16_t buffer_pos = page*128 + x;
	uint8_t c;
	
	while(c=*(str++))
	{
		c -= ' ';
		for(i = 0; i!= 6; ++i)
		{
			oled_buffer[buffer_pos] = oled_font_6x8[c][i];
			buffer_pos++;
		}
	}
}

void oled_draw_dot(uint8_t x, uint8_t y)
{
	volatile uint16_t buffer_pos;
	volatile uint8_t buffer_bit;
	if((x > 127 )|| (y > 64))return;
	buffer_pos = ((uint16_t)(y >> 3)) * 128;
	buffer_pos += x;
	buffer_bit = y & 0x07;
	oled_buffer[buffer_pos] |= bitmap[buffer_bit];
}

void oled_drawvline(uint8_t x, uint8_t y_start, uint8_t y_end)
{
	unsigned char bak;//用于对两个数互换的中间变量，使y1为大值
	if(y_start > y_end)
	{
		bak = y_end;
		y_end = y_start;
		y_start = bak;
	}
	do
	{
		oled_draw_dot(x , y_start);//从上到下逐点显示
		y_start ++;	
	}while(y_end >= y_start);
	/*
	uint8_t y_start1;
	uint8_t y_end1;
	if(y_start == y_end)
	{
		oled_draw_dot(x,y_start);
		return;
	}
	y_start1 = y_start >> 3;
	y_end1 = y_end >> 3;
	y_start = y_start & 0x07;
	y_end = y_end & 0x07;
	if(y_start)
	{
		oled_buffer[((uint16_t)y_start1 << 7) + x] |= ~bitmap1[y_start];
		y_start1++;
	}
	while(y_end1 - y_start1)
	{
		oled_buffer[((uint16_t)y_start1 << 7) + x] = 0xff;
		y_start1++;
		if(y_start1 == 8)
		{
			return;
		}
	}
	if(y_end)
	{
		oled_buffer[((uint16_t)y_start1 << 7) + x] |= bitmap1[y_end];
	}
	*/
}
//************画水平线函数**********************************//
//x0、x1为起始点和终点的水平坐标，y为垂直坐标***************//
//**********************************************************//
void oled_drawhline(uint8_t x0, uint8_t x1, uint8_t y)
{
	unsigned char bak;//用于对两个数互换的中间变量，使x1为大值
	if(x0 > x1)
	{
		bak = x1;
		x1 = x0;
		x0 = bak;
	}
	do
	{
		oled_draw_dot(x0, y);
		x0++;	
	}while(x1 >= x0);
}



//*********任意两点间画直线*********************************//
//x0、y0为起始点坐标，x1、y1为终点坐标**********************//
//**********************************************************//
void oled_draw_line(unsigned char x0 , unsigned char y0 , unsigned char x1 , unsigned char y1)
{
	uint8_t dx;//直线x轴差值
	uint8_t dy;//直线y轴差值
	uint8_t dx_sym;//x轴增长方向，为-1时减值方向，为1时增值方向
	uint8_t dy_sym;//y轴增长方向，为-1时减值方向，为1时增值方向
	uint8_t dx_x2;//dx*2值变量，用于加快运算速度
	uint8_t dy_x2;//dy*2值变量，用于加快运算速度
	uint8_t di;   //决策变量

	if(x0 == x1)//判断是否为垂直线
	{
		oled_drawvline(x0 , y0 , y1);//画垂直线
		return;
	}
	if(y0 == y1)//判断是否为水平线
	{
		oled_drawhline(x0 , x1 , y0);//画水平线
		return;
	}

	dx = x1 - x0;//求取两点之间的差值
	dy = y1 - y0;

	//****判断增长方向，或是否为水平线、垂直线、点*//
	if(dx > 0)//判断x轴方向
		dx_sym = 1;
	else
	{
		if(dx < 0)
			dx_sym = -1;
		else
		{
			oled_drawvline(x0 , y0 , y1);
			return;
		}
	}

	if(dy > 0)//判断y轴方向
		dy_sym = 1;
	else
	{
		if(dy < 0)
			dy_sym = -1;
		else
		{
			oled_drawvline(x0 , x1 , y0);
			return;
		}
	}


	/*将dx、dy取绝对值***********/
	dx = dx_sym * dx;
	dy = dy_sym * dy;

	/****计算2倍的dx、dy值*******/
	dx_x2 = dx * 1;//我改为了一倍，这样才跟真实的两点对应
	dy_x2 = dy * 1;

	/***使用bresenham法进行画直线***/
	if(dx >= dy)//对于dx>=dy，使用x轴为基准
	{
		di = dy_x2 - dx;
		while(x0 != x1)
		{
			oled_draw_dot(x0,y0);
			x0 +=dx_sym;
			if(di < 0)
				di += dy_x2;//计算出下一步的决策值
			else
			{
				di += dy_x2 - dx_x2;
				y0 += dy_sym;
			}	
		}
		oled_draw_dot(x0, y0);//显示最后一点
	}
	else  //对于dx<dy使用y轴为基准
	{
		di = dx_x2 - dy;
		while(y0 != y1)
		{
			oled_draw_dot(x0, y0);
			y0 += dy_sym;
			if(di < 0)
				di += dx_x2;
			else
			{
				di += dx_x2 - dy_x2;
				x0 += dx_sym;
			}
		}
		oled_draw_dot(x0, y0);//显示最后一点
	}
}

//////////////////////反白区域填充
void oled_fill_rect(int8_t x1, int8_t y1, int8_t x2, int8_t y2)
{
	int8_t y_start_full;						//完全填充开始
	int8_t y_end_full;							//完全填充截止
	uint8_t x, y;
	uint8_t tmp;	
	uint16_t buffer_pos;
	if((y1 > y2) || (x1 > x2))return;
	if((y1 == y2) && (x1 == x2))
	{
		oled_draw_dot(x1, y1);
		return;
	}
	y_start_full = y1/8;
	y1 = y1 %8;

	y_end_full = y2 /8;
	y2 = y2 %8;	
	
	if(y_start_full == y_end_full){	//只需改一页
		tmp = bitmap1[y2 - y1];
		tmp <<= y1;
		buffer_pos = y_end_full;
		if(buffer_pos == 8)buffer_pos--;
		buffer_pos *= 128;
		buffer_pos += x1;
		for(x = x1; x <= x2; ++x)
		{
			oled_buffer[buffer_pos] ^= tmp;
			buffer_pos++;
		}
		return;
	}
	
	if(y1 != 0)
	{
		tmp = ~(0xff >> (7-y1));
		buffer_pos = y_start_full;
		buffer_pos *= 128;
		buffer_pos += x1;
		for(x = x1; x <= x2; ++x)
		{
			oled_buffer[buffer_pos] ^= tmp;
			buffer_pos++;
		}
		y_start_full ++;	
	}
	
	if(y2 != 7)				//如果最后一页不是完整的
	{
		tmp = ~(0xff << (y2+1));
		buffer_pos = y_end_full;
		buffer_pos *= 128;
		buffer_pos += x1;
		for(x = x1; x <= x2; ++x)
		{
			oled_buffer[buffer_pos] ^= tmp;
			buffer_pos++;
		}
		y_end_full--;
	}
	if(y_start_full > y_end_full)return;
	//相同部分
	for(y = y_start_full; y <= y_end_full; ++y)
	{
		buffer_pos = y;
		buffer_pos *= 128;
		buffer_pos += x1;
		tmp = 0xff;
		for(x = x1; x <= x2; ++x)
		{
			oled_buffer[buffer_pos] ^= tmp;
			buffer_pos++;
		}
	}
}
//////////////////////////////////////////////////////////////
//////////////////////////汉字显示
//////////////////////////////////////////////////////////////
bit has_gb2312(uint8_t *str)
{
	uint8_t c;
	while(c = *str++)
	{
		if(c >= 0xa1)
			return 1;
	}
	return 0;
}

void oled_draw_bitmap_fast(uint8_t x, uint8_t yy, uint8_t* bitmap, uint8_t w, uint8_t h, uint8_t invert, uint8_t offsetY)
{
	uint8_t ww, hh;
	uint8_t y = yy - offsetY;
	uint8_t pixels;
	uint8_t h2 = h / 8;

	uint8_t pixelOffset = (y % 8);
	uint8_t thing3 = (yy+h);
	
	// 
	for(hh = 0; hh < h2; ++hh)
	{
		// 
		uint8_t hhh = (hh * 8) + y; // Current Y pos (every 8 pixels)
		uint8_t hhhh = hhh + 8; // Y pos at end of pixel column (8 pixels)
		uint8_t offsetMask = 0xFF;
		uint16_t aa = ((hhh / 8) * OLED_X_MAX);
		
		const uint8_t* b = bitmap + (hh*w);
		
		// 
		if(offsetY && (hhhh < yy || hhhh > OLED_Y_MAX || hhh > thing3))
			continue;

		// 
		if(offsetY)
		{
			if(hhh < yy)
				offsetMask = (0xFF<<(yy-hhh));
			else if(hhhh > thing3)
				offsetMask = (0xFF>>(hhhh-thing3));
		}


		// If() outside of loop makes it faster (doesn't have to keep re-evaluating it)
		// Downside is code duplication
		if(!pixelOffset && hhh < OLED_Y_MAX)
		{
			// 
			for(ww = 0; ww < w; ++ww)
			{
				// Workout X co-ordinate in frame buffer to place next 8 pixels
				uint8_t xx = ww + x;
			
				// Stop if X co-ordinate is outside the frame
				if(xx >= OLED_X_MAX)
					continue;

				// Read pixels
				//uint8_t pixels = readPixels(b + ww, invert) & offsetMask;
				
				pixels = *(b + ww);
				if(invert)
					pixels = ~pixels;
				pixels &= offsetMask;
				
				oled_buffer[xx + aa] |= pixels;

				//setBuffuint8_t(buff, xx, hhh, pixels, colour);
			}
		}
		else
		{
			uint16_t aaa = ((hhhh / 8) * OLED_X_MAX);
			
			// 
			for(ww = 0; ww < w; ++ww)
			{
				// Workout X co-ordinate in frame buffer to place next 8 pixels
				uint8_t xx = ww + x;
		
				// Stop if X co-ordinate is outside the frame
				if(xx >= OLED_X_MAX)
					continue;

				// Read pixels
				pixels = *(b + ww);
				if(invert)
					pixels = ~pixels;
				pixels &= offsetMask;

				// 
				if(hhh < OLED_Y_MAX)
					oled_buffer[xx + aa] |= pixels << pixelOffset;
					//setBuffuint8_t(buff, xx, hhh, pixels << pixelOffset, colour);				

				// 
				if(hhhh < OLED_Y_MAX)
					oled_buffer[xx + aaa] |= pixels >> (8 - pixelOffset);
					//setBuffuint8_t(buff, xx, hhhh, pixels >> (8 - pixelOffset), colour);		
			}
		}
	}
}
